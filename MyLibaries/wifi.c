#include "wifi.h"
#include "5110.h"
//#include "stm32f4lib.h"
#define wifi_CS_H IO1(IOCB,PIN13)
#define wifi_CS_L IO0(IOCB,PIN13)
#define wifi_BUSY PCin(14)
#define wifi_INT  PCin(15)
const u8 image2send[20000]= \
 { \
255,  216,  255,  224,  0,    16,   74,   70,   73,   70,   0,    1,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  217,  
 };
//SPI->SPI2
//CS->C13
//BUSY->C14
//INT->C15


static void MSend(unsigned char *array); 
void Mputs(u8 *array,u32 lenth);
__inline u8 MSend_atom(u8 temp)
{
   while (SPI_I2S_GetFlagStatus(SPI2, SPI_I2S_FLAG_TXE) == RESET);
   SPI_I2S_SendData(SPI2, temp);
   while (SPI_I2S_GetFlagStatus(SPI2, SPI_I2S_FLAG_RXNE) == RESET);
   return SPI2->DR;
}


u8 setWIFI_name[0x5a]= \
{ \
   0xAA,0x01,0x5A,0x00,0x02,0x04,0x00,0x00,0x00,0x00,0x00, \
   0x00,0x00,0x00,0x00,0x00,0x00,0x01,0x01,0x00,0x62,0x6C, \
   0x61,0x63,0x6B,0x6D,0x69,0x61,0x6F,0x6F,0x6c,0x00,0x00, \
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   0x38,0x55 \
};
u8 setip[0x0f]= \
{ \
   0xAA,0x07,0x0F,0x00,0x03,0x01,0x01,0xC0,0xA8,0x01,0x16,0x05,0x0D,0x7C,0x55 \
};
u8 sent_test[0x0a]= \
{ \
   0xAA,0x0B,0x0A,0x00,0x11,0x64,0x65,0x66,0x77,0x55 \
};
u8 sent_baund[0x5A]= \
{ \
   0xAA,0x01,0x5A,0x00,0x02,0x02,0x00,0x00,0x00,0x00,0x00, \
   0x00,0x00,0x10,0x55,0x22,0x00,0x00,0x00,0x00,0x00,0x00, \
   0x00,0x00,0x00,0x00,0x00,0x00,0x00,0x00,0x00,0x00,0x00, \
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   0x98,0x55 \
};
void delay_s(u32 sec)
{
   u32 i=0;
   for(i=0;i<sec;i++)
   {
      delay_ms(500);
      delay_ms(500);
   }
}
__inline void send_byte(u8 byte2send)
{

	 USART3->DR = byte2send;
	while((USART3->SR & USART_FLAG_TC) == (uint16_t)RESET);
	delay_us(4);//decrease to quicken
}
__inline void send_package(u8 *buf,u16 lenth)
{
	u16 i=0;
	u8 sum=0;
	send_byte(0xAA);
	send_byte(0x0B);
	send_byte((lenth+7)&0XFF);
	send_byte((lenth+7)/0X100);
	send_byte(0X11);
	for(i=0;i<lenth;i++)
	{
		send_byte(buf[i]);
	}
	sum=0x0b;
	sum^=((lenth+7)&0XFF);
	sum^=((lenth+7)/0X100);
	sum^=0X11;
	for(i=0;i<lenth;i++)
	{
		sum^=buf[i];
	}
	send_byte(sum);
	send_byte(0x55);
	delay_ms(8);//decrease to quicken

}
__inline void send_lenth(u32 lenth)
{
	u8 lenth_array[10];
	*((u32 *)(lenth_array+6))=lenth;
	lenth_array[0]=0xf4;
	lenth_array[1]=0xf3;
	lenth_array[2]=0xf2;
	lenth_array[3]=0x04;
	lenth_array[4]=0x03;
	lenth_array[5]=0x02;
	send_package(lenth_array,10);
}
void send_image(u8 *image,u16 lenth)  //401  1
{
	u16 i=0;
	u16 cnt;
	cnt=lenth/400;
	send_lenth(lenth);
	for(i=0;i<cnt;i++)
	{
		send_package(image+i*400,400);
	}
	if(lenth%400)
	{
		send_package(image+cnt*400,lenth%400);
	}

}

void wifi_Init()
{
	u32 i=0;

	//while(1)
	//{
		//recevie_flag=1;		
	while(GPIODin(7));
		MSend(setip);	
		//while(recevie_flag);
		//if(!recevie_buf[6])
		//{
			//recevie_buf[5]=0;recevie_buf[6]=0;recevie_buf[7]=0;recevie_buf[8]=0;
		  //break;
		//}
	//}
	write_count(5,5,9999);
	delay_s(1);
	MSend(sent_baund);
	delay_s(1);
	USART_Config();
	USART_printf(USART3, "1");
	delay_s(1);

}

void Mputs(u8 *array,u32 lenth)
{
   u32 i=0;
   for(i=0;i<lenth;i++)     
	{
      USART_SendData(USART3, array[i]);
      while((USART3->SR & USART_FLAG_TC) == (uint16_t)RESET);
      delay_us(1);
   }
}

static void MSend(unsigned char *array)
{
   u32 i=0;
   u32 lenth=0;
   u8 sum=0;
   sum=array[1];
   lenth=(array[3]<<8)+array[2];
   for(i=2;i<lenth-2;i++)
   {
      sum^=array[i];
   }
   array[lenth-2]=sum;

   Mputs(array,lenth);     
   
}




//#define PAUSE GPIOGout(2)
/*u8 *receive_tcp()
{
	u16 timeout=0xffff;
	PAUSE = 1 ;
	recevie_flag = 1 ;
	PAUSE = 0 ;
	//while( PAUSE );
	while( recevie_flag && timeout--);
	if(timeout)
		return recevie_buf;
	else
		return NULL;
}*/














